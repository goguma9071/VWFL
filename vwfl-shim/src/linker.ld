ENTRY(_start)

SECTIONS {

    . = 0x10000;

    .text : {
        *(.text._start)
        *(.text*)
    }

    .rodata : {
        *(.rodata*)

    }

    .data : {
        *(.data*)

    }

    .bss : {
        *(.bss*)

    }

}

